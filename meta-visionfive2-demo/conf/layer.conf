## meta-visionfive2-demo/conf/layer.conf
```bitbake
# Priority above meta-riscv (6), so the demo's bbappends win.

BBPATH .= ":${LAYERDIR}"

BBFILES += "${LAYERDIR}/recipes-*/*/*.bb \
            ${LAYERDIR}/recipes-*/*/*.bbappend"

BBFILE_COLLECTIONS += "visionfive2-demo"
BBFILE_PATTERN_visionfive2-demo = "^${LAYERDIR}/"
BBFILE_PRIORITY_visionfive2-demo = "10"

LAYERDEPENDS_visionfive2-demo = "core riscv-layer"
LAYERSERIES_COMPAT_visionfive2-demo = "blacksail"
```
