/dts-v1/;
/plugin/;

/* Applied to mainline U-Boot 2026.01's control FDT with `fdt apply`. Nodes from the
 * linux-starfive-dev 6.12.5 DTB; phandles 0x41->&aoncrg 0x03->&syscrg 0x3b->&pwrc. */

/ {
	fragment@0 {
		target-path = "/soc";
		__overlay__ {
			/* Real-time clock (jh7110 RTC; needs aoncrg pclk/cal_clk) */
			rtc@17040000 {
				compatible = "starfive,jh7110-rtc";
				reg = <0x00 0x17040000 0x00 0x10000>;
				interrupts = <0x0a 0x0b 0x0c>;
				interrupt-names = "rtc_ms_pulse", "rtc_sec_pulse", "rtc";
				clocks = <&aoncrg 0x0a &aoncrg 0x0d>;
				clock-names = "pclk", "cal_clk";
				resets = <&aoncrg 0x07 &aoncrg 0x05 &aoncrg 0x06>;
				reset-names = "rst_osc", "rst_apb", "rst_cal";
				rtc,cal-clock-freq = <0xf4240>;
				status = "okay";
			};

			/* vpu_dec@130a0000 left out: no /reserved-memory here, so wave5 oopses at probe.
			 * TODO(owen): add a linux,cma /reserved-memory node (or cma=), then add it. */
		};
	};
};
